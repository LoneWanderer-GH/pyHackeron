## esp32/Kconfig.projbuild
```kconfig
menu "Corelec configuration"

    config CORELEC_WIFI_SSID
        string "WiFi SSID"
        default "mon_ssid"
        help
            SSID du réseau WiFi auquel l'ESP32 se connecte.

    config CORELEC_WIFI_PASSWORD
        string "WiFi password"
        default ""
        help
            Mot de passe du réseau WiFi.

    config CORELEC_MQTT_BROKER_URL
        string "MQTT broker URL"
        default "mqtt://192.168.1.1"
        help
            URL du broker MQTT, ex. mqtt://192.168.1.100:1883

    config CORELEC_BLE_DEVICE_ADDR
        string "BLE device MAC address"
        default "AA:BB:CC:DD:EE:FF"
        help
            Adresse MAC BLE du régulateur Corelec (format XX:XX:XX:XX:XX:XX).

    config CORELEC_BLE_ADDR_TYPE_RANDOM
        bool "BLE address type is random (vs public)"
        default n
        help
            Cocher si l'adresse BLE de l'appareil est de type aléatoire.

endmenu
```

## esp32/sdkconfig.defaults
```kconfig
# ── Bluetooth / NimBLE ──────────────────────────────────────────────────────
CONFIG_BT_ENABLED=y
CONFIG_BT_NIMBLE_ENABLED=y
CONFIG_BT_CONTROLLER_MODE_BLE_ONLY=y
CONFIG_BT_NIMBLE_ROLE_CENTRAL=y
CONFIG_BT_NIMBLE_ROLE_PERIPHERAL=n
CONFIG_BT_NIMBLE_ROLE_BROADCASTER=n
CONFIG_BT_NIMBLE_ROLE_OBSERVER=y
CONFIG_BT_NIMBLE_MAX_CONNECTIONS=1
CONFIG_BT_NIMBLE_LOG_LEVEL=1

# ── WiFi ─────────────────────────────────────────────────────────────────────
CONFIG_ESP_WIFI_ENABLED=y

# ── MQTT ─────────────────────────────────────────────────────────────────────
CONFIG_MQTT_PROTOCOL_311=y
CONFIG_MQTT_TRANSPORT_SSL=n

# ── Logging ──────────────────────────────────────────────────────────────────
CONFIG_LOG_DEFAULT_LEVEL_INFO=y

# ── Stack sizes ───────────────────────────────────────────────────────────────
# NimBLE host task stack (increase if stack overflow observed)
CONFIG_BT_NIMBLE_HOST_TASK_STACK_SIZE=5120
```
